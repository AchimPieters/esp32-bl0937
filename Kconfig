## Kconfig
```kconfig
menu "BL0973 (BL09x7) Energy Meter"

config BL0973_ENABLE
    bool "Enable BL0973 driver"
    default y
    help
        Enable the BL0973/BL0937-style energy meter driver.

config BL0973_GPIO_CF
    int "GPIO for CF (active power / overcurrent pulse output)"
    default 4
    range -1 48
    help
        GPIO connected to CF. Set to -1 to disable (not recommended).

config BL0973_GPIO_CF1
    int "GPIO for CF1 (RMS pulse output)"
    default 5
    range -1 48
    help
        GPIO connected to CF1. Set to -1 to disable.

config BL0973_GPIO_SEL
    int "GPIO for SEL (CF1 select)"
    default 6
    range -1 48
    help
        GPIO connected to SEL. SEL=0 => IRMS on CF1, SEL=1 => VRMS on CF1.

config BL0973_SEL_ACTIVE_HIGH
    bool "SEL active-high (default)"
    default y
    help
        If enabled: SEL GPIO level '1' means SEL=1.
        If disabled: logic is inverted.

config BL0973_CF_ACTIVE_HIGH
    bool "CF/CF1 pulses are active-high (default)"
    default y
    help
        Datasheet indicates active high pulses. Disable only if your board inverts the signal.

config BL0973_USE_GPIO_PULLUPS
    bool "Enable internal pull-ups on CF/CF1 (if needed)"
    default n
    help
        Enable internal pull-ups. Normally not required if you have external pull resistors.


config BL0973_AUTOSTART
    bool "Autostart measuring (start timer automatically)"
    default y
    help
        If enabled, the component starts measuring immediately after init.
        If disabled, call bl0973_start() manually.

config BL0973_UPDATE_PERIOD_MS
    int "Update period (ms)"
    default 200
    range 50 2000
    help
        Period at which the driver reads pulse counts and updates computed values.

config BL0973_TOGGLE_SEL_EVERY_UPDATE
    bool "Auto toggle SEL every update"
    default y
    help
        If enabled, the driver alternates CF1 between IRMS and VRMS on each update tick.

config BL0973_SEL_STABLE_US
    int "SEL settle time (us)"
    default 50
    range 10 5000
    help
        Delay after toggling SEL before counting pulses is considered stable.

config BL0973_EMA_ALPHA_PERMILLE
    int "Exponential moving average alpha (permille)"
    default 250
    range 0 1000
    help
        0 = no update, 1000 = no filtering (raw).
        Recommended 150..400.


config BL0973_SIGNAL_TIMEOUT_MS
    int "Signal timeout (ms) for validity flags"
    default 3000
    range 100 600000
    help
        If no relevant pulses arrive for this duration, the corresponding measurement is marked invalid.

config BL0973_MIN_VALID_FREQ_HZ
    int "Minimum valid pulse frequency (mHz)"
    default 200
    range 0 100000
    help
        Minimum pulse frequency for a channel to be considered valid, in milli-Hz.
        0 disables the frequency threshold.

config BL0973_VREF_MV
    int "Chip reference voltage (mV)"
    default 1218
    range 1000 1400
    help
        On-chip voltage reference typical 1.218V.

config BL0973_SHUNT_UOHM
    int "Shunt resistor (micro-ohm)"
    default 1000
    range 100 10000
    help
        Value of the current shunt in micro-ohm. Example: 1mΩ => 1000uΩ.

config BL0973_DIVIDER_RATIO_NUM
    int "Divider ratio numerator (Vinput = Vmains * num/den)"
    default 1
    range 1 1000000

config BL0973_DIVIDER_RATIO_DEN
    int "Divider ratio denominator (Vinput = Vmains * num/den)"
    default 1000
    range 1 1000000

config BL0973_CAL_VOLTAGE_PERMILLE
    int "Voltage calibration (permille)"
    default 1000
    range 100 10000
    help
        1000 = 1.000. Multiply computed voltage by this factor / 1000.

config BL0973_CAL_CURRENT_PERMILLE
    int "Current calibration (permille)"
    default 1000
    range 100 10000

config BL0973_CAL_POWER_PERMILLE
    int "Power calibration (permille)"
    default 1000
    range 100 10000

config BL0973_CAL_VOLTAGE_OFFSET_MV
    int "Voltage offset (mV) added after calibration"
    default 0
    range -50000 50000

config BL0973_CAL_CURRENT_OFFSET_MA
    int "Current offset (mA) added after calibration"
    default 0
    range -50000 50000


config BL0973_ENABLE_APPARENT_POWER
    bool "Compute apparent power (VA)"
    default y

config BL0973_ENABLE_REACTIVE_POWER
    bool "Compute reactive power (var) (sqrt(S^2-P^2))"
    default y


config BL0973_ENABLE_NVS_ENERGY
    bool "Persist energy counter (CF pulses) in NVS"
    default n
    help
        If enabled, the component periodically saves the accumulated CF pulse counter to NVS,
        so energy can continue after reboot.

config BL0973_NVS_ENERGY_SAVE_INTERVAL_S
    int "Energy save interval (seconds)"
    depends on BL0973_ENABLE_NVS_ENERGY
    default 60
    range 1 86400

config BL0973_NVS_ENERGY_KEY
    string "NVS key for energy pulse counter"
    depends on BL0973_ENABLE_NVS_ENERGY
    default "pulses"

config BL0973_ENABLE_NVS_CALIBRATION
    bool "Store calibration in NVS (optional)"
    default n
    help
        If enabled, calibration factors can be saved and restored from NVS.

config BL0973_NVS_NAMESPACE
    string "NVS namespace"
    depends on BL0973_ENABLE_NVS_CALIBRATION
    default "bl0973"

config BL0973_ENABLE_RELAY_CUTOFF
    bool "Enable relay cutoff output for overcurrent protection"
    default n

config BL0973_GPIO_RELAY
    int "GPIO for relay control"
    depends on BL0973_ENABLE_RELAY_CUTOFF
    default 7
    range -1 48

config BL0973_RELAY_ACTIVE_HIGH
    bool "Relay active-high"
    depends on BL0973_ENABLE_RELAY_CUTOFF
    default y


config BL0973_RELAY_INITIAL_ON
    bool "Relay initial state ON"
    depends on BL0973_ENABLE_RELAY_CUTOFF
    default y
    help
        If enabled, relay GPIO is set to ON during init.

config BL0973_RELAY_DEFAULT_ON_AFTER_RECOVER
    bool "Relay defaults to ON after overcurrent recover"
    depends on BL0973_ENABLE_RELAY_CUTOFF
    default y
    help
        If enabled, relay will automatically turn ON when cooldown ends.
        If disabled, relay stays OFF after recover until bl0973_relay_set(true) is called.


config BL0973_OVERCURRENT_THRESHOLD_MA
    int "Overcurrent threshold (mA)"
    default 16000
    range 1000 60000

config BL0973_OVERCURRENT_DEBOUNCE_MS
    int "Overcurrent debounce (ms)"
    default 200
    range 0 5000

config BL0973_OVERCURRENT_COOLDOWN_S
    int "Overcurrent cooldown (s)"
    default 30
    range 1 3600

config BL0973_ENABLE_HW_OC_DETECT
    bool "Use CF over-current pulse (6.7kHz) as immediate trip (optional)"
    default y
    help
        Datasheet: CF outputs ~6.7kHz pulse when IC detects over-current condition.

config BL0973_HW_OC_FREQ_HZ
    int "Hardware over-current frequency (Hz)"
    depends on BL0973_ENABLE_HW_OC_DETECT
    default 6700
    range 1000 50000

config BL0973_HW_OC_FREQ_TOLERANCE_PCT
    int "Hardware OC frequency tolerance (%)"
    depends on BL0973_ENABLE_HW_OC_DETECT
    default 15
    range 1 50

endmenu
```

## Kconfig.projbuild
```kconfig
menu "BL0937 Energy Monitor"

config BL0937_ENABLE
    bool "Enable BL0937 driver"
    default y
    help
        Enables the BL0937 component and its configuration options.

config ESP_BL0937_CF_GPIO
    int "CF GPIO (pulse input)"
    depends on BL0937_ENABLE
    default 34 if IDF_TARGET_ESP32
    default 4  if IDF_TARGET_ESP32C3
    range 0 39
    help
        BL0937 CF output -> ESP32 input (pulse count).


config ESP_BL0937_CF1_GPIO
    int "CF1 GPIO (pulse input)"
    depends on BL0937_ENABLE
    default 35 if IDF_TARGET_ESP32
    default 5  if IDF_TARGET_ESP32C3
    range 0 39
    help
        BL0937 CF1 output -> ESP32 input (pulse count).


config ESP_BL0937_SEL_GPIO
    int "SEL GPIO (output)"
    depends on BL0937_ENABLE
    default 25 if IDF_TARGET_ESP32
    default 21 if IDF_TARGET_ESP32C3
    range 0 39
    help
        BL0937 SEL control -> ESP32 output.
        On ESP32: must be output-capable (0..33). Do NOT use GPIO34..39.


config BL0937_VREF_V
    string "BL0937 Vref voltage (V)"
    depends on BL0937_ENABLE
    default "1.218"
    help
        Reference voltage used in datasheet formulas. Typical value is 1.218V.

config BL0937_SHUNT_UOHM
    int "Shunt value (micro-ohms)"
    depends on BL0937_ENABLE
    default 1000
    range 1 100000000
    help
        Shunt resistor value in micro-ohms (uΩ). Example: 1 mΩ = 1000 uΩ.

config BL0937_V_DIV_RATIO
    string "Voltage divider ratio (Vpin_rms / Vline_rms)"
    depends on BL0937_ENABLE
    default "0.00100"
    help
        Ratio between BL0937 voltage input RMS and mains RMS.

config BL0937_SAMPLE_PERIOD_MS
    int "Sample period (ms)"
    depends on BL0937_ENABLE
    default 1000
    range 100 10000
    help
        Full measurement period. The driver measures CF1 voltage for half of this,
        then CF1 current for the other half, and updates results once per period.

config BL0937_SEL_SETTLE_US
    int "SEL settle time (us)"
    depends on BL0937_ENABLE
    default 200
    range 0 5000
    help
        Delay after toggling SEL before counting CF1 pulses.

config BL0937_GLITCH_FILTER_NS
    int "Glitch filter (ns, PCNT only)"
    depends on BL0937_ENABLE
    default 1000
    range 0 100000
    help
        Pulse glitch filter time in nanoseconds for PCNT. Set 0 to disable.

config BL0937_VOLTAGE_CAL
    string "Voltage calibration multiplier"
    depends on BL0937_ENABLE
    default "1.000"

config BL0937_CURRENT_CAL
    string "Current calibration multiplier"
    depends on BL0937_ENABLE
    default "1.000"

config BL0937_POWER_CAL
    string "Power calibration multiplier"
    depends on BL0937_ENABLE
    default "1.000"

config BL0937_ISR_FALLBACK
    bool "Force GPIO ISR counting (disable PCNT even if available)"
    depends on BL0937_ENABLE
    default n

endmenu
```

## dist/esp32-bl0937_1.0.0/Kconfig
```kconfig
menu "BL0937"

    config BL0937_DEFAULT_SAMPLE_MS
        int "Default sample interval (ms)"
        default 1000
        help
            Default time window used by the example and as a convenience default.

endmenu
```

## dist/esp32-bl0937_1.2.0/Kconfig
```kconfig
menu "BL0937"

    config BL0937_DEFAULT_SAMPLE_MS
        int "Default sample interval (ms)"
        default 1000
        help
            Default time window used by the example and as a convenience default.

    config BL0937_DEFAULT_EMA_ALPHA_V
        float "Default EMA alpha (voltage)"
        default 0.15
        help
            Low-pass filter factor for VRMS. Lower values mean stronger filtering and
            slower response; higher values track faster but keep more noise.

    config BL0937_DEFAULT_EMA_ALPHA_I
        float "Default EMA alpha (current)"
        default 0.12
        help
            Low-pass filter factor for IRMS.

    config BL0937_DEFAULT_EMA_ALPHA_P
        float "Default EMA alpha (power)"
        default 0.10
        help
            Low-pass filter factor for active power (CF average).

endmenu
```

## dist/esp32-bl0937_1.2.0/examples/basic/sdkconfig.defaults
```kconfig
CONFIG_FREERTOS_HZ=1000
CONFIG_BL0937_DEFAULT_SAMPLE_MS=400
CONFIG_BL0937_DEFAULT_EMA_ALPHA_V=0.12
CONFIG_BL0937_DEFAULT_EMA_ALPHA_I=0.10
CONFIG_BL0937_DEFAULT_EMA_ALPHA_P=0.08
```

## dist/esp32-bl0937_1.2.3/Kconfig
```kconfig
menu "BL0937"

    config BL0937_DEFAULT_SAMPLE_MS
        int "Default sample interval (ms)"
        default 1000
        help
            Default time window used by the example and as a convenience default.

    config BL0937_DEFAULT_EMA_ALPHA_V
        int "Default EMA alpha (voltage) x1000"
        range 0 1000
        default 200
        help
            EMA alpha as fixed-point value (alpha * 1000).
            Example: 0.200 -> 200

    config BL0937_DEFAULT_EMA_ALPHA_I
        int "Default EMA alpha (current) x1000"
        range 0 1000
        default 200

    config BL0937_DEFAULT_EMA_ALPHA_P
        int "Default EMA alpha (power) x1000"
        range 0 1000
        default 200

endmenu
```

## dist/esp32-bl0937_2.5.0/Kconfig
```kconfig
menu "BL0937 Energy Monitor"

config ESP_BL0937_CF_GPIO
    int "CF GPIO"
    default 25
    help
        GPIO pin connected to CF (power) output.

config ESP_BL0937_CF1_GPIO
    int "CF1 GPIO"
    default 26
    help
        GPIO pin connected to CF1 (voltage/current) output.

config ESP_BL0937_SEL_GPIO
    int "SEL GPIO"
    default 27
    help
        GPIO pin connected to SEL input.

config ESP_BL0937_SEL_INVERTED
    bool "Invert SEL logic"
    default n
    help
        Enable if the SEL pin logic is inverted by external circuitry.

config ESP_BL0937_VOLTAGE_CAL
    string "Voltage calibration constant"
    default "1.0"
    help
        Calibration divisor for voltage measurement.

config ESP_BL0937_CURRENT_CAL
    string "Current calibration constant"
    default "1.0"
    help
        Calibration divisor for current measurement.

config ESP_BL0937_POWER_CAL
    string "Power calibration constant"
    default "1.0"
    help
        Calibration divisor for power measurement.

config ESP_BL0937_POWER_MAX
    string "Maximum power (watts)"
    default "0.0"
    help
        Optional upper limit for valid power measurements.

config ESP_BL0937_FREQUENCY_HZ
    string "Mains frequency (Hz)"
    default "50.0"
    help
        Mains frequency in Hz.

config ESP_BL0937_SAMPLE_PERIOD_MS
    int "Sample period (ms)"
    default 1000
    help
        Time between measurement updates.

endmenu
```

## examples/basic/sdkconfig.defaults
```kconfig
CONFIG_FREERTOS_HZ=1000
CONFIG_BL0937_DEFAULT_SAMPLE_MS=400
CONFIG_BL0937_DEFAULT_EMA_ALPHA_V=120
CONFIG_BL0937_DEFAULT_EMA_ALPHA_I=100
CONFIG_BL0937_DEFAULT_EMA_ALPHA_P=80
```
